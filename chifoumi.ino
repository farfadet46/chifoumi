
#include <SPI.h>
#include <Wire.h>
#include <Adafruit_GFX.h>
#include <Adafruit_SSD1306.h>

#define SCREEN_WIDTH 128 // Largeur de l'écran OLED en pixels
#define SCREEN_HEIGHT 64 // Hauteur de l'écran OLED en pixels

#define LOGO_HEIGHT   60
#define LOGO_WIDTH    60

#define OLED_RESET -1 // Pin de reset (ou -1 si partagé avec le reset de l'Arduino)
#define SCREEN_ADDRESS 0x3C // Adresse I2C de l'écran OLED
Adafruit_SSD1306 display(SCREEN_WIDTH, SCREEN_HEIGHT, &Wire, OLED_RESET);

#define btnpin 2 // Pin du bouton
int randNumber; // Nombre aléatoire pour sélectionner une image

// Définition des images en PROGMEM

static const unsigned char PROGMEM sciseau[] =
{ // 'sciseau', 60x60px
0x00, 0x00, 0x00, 0x0f, 0x80, 0x00, 0x00, 0x00, 0x00, 0x07, 0xf0, 0x1f, 0xc0, 0x00, 0x00, 0x00, 
0x00, 0x0f, 0xf8, 0x3f, 0xe0, 0x00, 0x00, 0x00, 0x00, 0x0f, 0xf8, 0x7f, 0xf0, 0x00, 0x00, 0x00, 
0x00, 0x1f, 0x7c, 0x78, 0xf0, 0x00, 0x00, 0x00, 0x00, 0x1e, 0x3c, 0x78, 0xf0, 0x00, 0x00, 0x00, 
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0x00, 0x00, 0x7f, 0xff, 0xff, 0xf8, 0x00, 0x00, 0x00, 0x00, 0x7f, 0xff, 0xff, 0xf8, 0x00, 0x00, 
};
static const unsigned char PROGMEM feuille[] =
{ // 'feuille', 60x60px
0x00, 0x00, 0x00, 0x03, 0xe0, 0x00, 0x00, 0x00, 0x00, 0x00, 0x00, 0x07, 0xf8, 0x00, 0x00, 0x00, 
0x00, 0x00, 0x00, 0x0f, 0xf8, 0x00, 0x00, 0x00, 0x00, 0x00, 0x00, 0x1f, 0xfc, 0x00, 0x00, 0x00, 
0x00, 0x00, 0x00, 0x1e, 0x3f, 0xe0, 0x00, 0x00, 0x00, 0x00, 0x01, 0xfe, 0x1f, 0xf0, 0x00, 0x00, 
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0x00, 0x00, 0x00, 0x7f, 0xff, 0xfc, 0x00, 0x00, 0x00, 0x00, 0x00, 0x0f, 0xff, 0xf0, 0x00, 0x00, 
};
static const unsigned char PROGMEM pierre[] =
{ // 'pierre', 60x60px
0x00, 0x00, 0x00, 0x3f, 0x00, 0x00, 0x00, 0x00, 0x00, 0x00, 0x00, 0xff, 0xc0, 0x00, 0x00, 0x00, 
0x00, 0x01, 0xf9, 0xff, 0xe0, 0x00, 0x00, 0x00, 0x00, 0x07, 0xff, 0xff, 0xf7, 0xf0, 0x00, 0x00, 
0x00, 0x0f, 0xff, 0xe0, 0xff, 0xf8, 0x00, 0x00, 0x00, 0x0f, 0xff, 0xc0, 0xff, 0xfc, 0x00, 0x00, 
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0x00, 0x07, 0xff, 0xff, 0xff, 0xff, 0xf0, 0x00, 0x00, 0x07, 0xff, 0xff, 0xff, 0xff, 0xf0, 0x00
};



void setup() {
    // Initialisation du bouton
    pinMode(btnpin, INPUT_PULLUP);
    
    // Initialisation de l'écran OLED
    if(!display.begin(SSD1306_SWITCHCAPVCC, SCREEN_ADDRESS)) {
        Serial.println(F("SSD1306 allocation failed"));
        for(;;);
    }
    
    display.clearDisplay();
    display.setTextSize(2);
    display.setTextColor(SSD1306_WHITE);
    display.setCursor(0, 10);
    display.print(F("Bienvenue!"));
    display.display();
    delay(1500);
    attente();
}

void attente()
{
  display.clearDisplay();
  display.setCursor(0, 0);
  display.setTextSize(2);
  display.print(F("APPUIE SUR"));
  display.println(F("LE BOUTON"));
  display.display();
}

void loop() {
    if (digitalRead(btnpin) == LOW) {
        delay(200); // Debounce

        // Affichage du compte à rebours
        for (int i = 3; i > 0; i--) {
            display.clearDisplay();
            display.setTextSize(4);
            display.setCursor(50, 20);
            display.print(i);
            display.display();
            delay(1000);
        }

        randNumber = random(3); // Génère un nombre entre 0 et 2
        display.clearDisplay();
        
        switch(randNumber) {
            case 0:
                display.drawBitmap( (display.width()  - LOGO_WIDTH ) / 2, (display.height() - LOGO_HEIGHT) / 2, pierre, LOGO_WIDTH, LOGO_HEIGHT, 1);
                break;
            case 1:
                display.drawBitmap( (display.width()  - LOGO_WIDTH ) / 2, (display.height() - LOGO_HEIGHT) / 2, feuille, LOGO_WIDTH, LOGO_HEIGHT, 1);
                break;
            case 2:
                display.drawBitmap( (display.width()  - LOGO_WIDTH ) / 2, (display.height() - LOGO_HEIGHT) / 2, sciseau, LOGO_WIDTH, LOGO_HEIGHT, 1);
                break;
        }
        display.display();
        delay(2000);
        attente();
    }
}

